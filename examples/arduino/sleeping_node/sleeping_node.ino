#include <Arduino.h>
#include <EspNowNode.h>
#include <EspNowPreferences.h>
#include <GCMEncryption.h>
#include <esp_crt_bundle.h>

#define SLEEP_TIME_US (1000LL * 1000LL * 60LL * 1LL) // 1 minute

// Should be generated by build script.
#define FIRMWARE_VERSION 90201

// These structs are the application messages shared across the host and node device.
// Ideally these should live in a shared header file.
#pragma pack(1)
struct MyApplicationMessage {
  uint8_t id = 0x01;
  double temperature;
};
#pragma pack(0)

// Encyption key used for our own packet encryption (GCM).
// We are not using the esp-now encryption due to the peer limitation.
// The key should be the same for both the host and the node.
const char esp_now_encryption_key[] = "0123456789ABCDEF"; // Must be exact 16 bytes long. \0 does not count.

// Used to validate the integrity of the messages.
// The secret should be the same for both the host and the node.
const char esp_now_encryption_secret[] = "01234567"; // Must be exact 8 bytes long. \0 does not count.

unsigned long _turn_of_led_at_ms = 0;

// Callback for logging. Can be omitted.
EspNowNode::OnLog _on_log = [](const std::string message, const esp_log_level_t log_level) {
  if (log_level == ESP_LOG_NONE) {
    return; // Weird flex, but ok
  }

  std::string level;
  switch (log_level) {
  case ESP_LOG_NONE:
    level = "none";
    break;
  case ESP_LOG_ERROR:
    level = "error";
    break;
  case ESP_LOG_WARN:
    level = "warning";
    break;
  case ESP_LOG_INFO:
    level = "info";
    break;
  case ESP_LOG_DEBUG:
    level = "debug";
    break;
  case ESP_LOG_VERBOSE:
    level = "verbose";
    break;
  default:
    level = "unknown";
    break;
  }

  Serial.println(("EspNowNode (" + level + "): " + message).c_str());
};

// Status callback. Can be omitted.
EspNowNode::OnStatus _on_status = [](EspNowNode::Status status) {
  switch (status) {
  case EspNowNode::Status::HOST_DISCOVERY_STARTED:
    break;
  case EspNowNode::Status::HOST_DISCOVERY_SUCCESSFUL:
    break;
  case EspNowNode::Status::HOST_DISCOVERY_FAILED:
    break;
  case EspNowNode::Status::INVALID_HOST:
    break;
  case EspNowNode::Status::FIRMWARE_UPDATE_STARTED:
    break;
  case EspNowNode::Status::FIRMWARE_UPDATE_SUCCESSFUL:
    break;
  case EspNowNode::Status::FIRMWARE_UPDATE_FAILED:
    break;
  case EspNowNode::Status::FIRMWARE_UPDATE_WIFI_SETUP_FAILED:
    break;
  }
};

EspNowPreferences _esp_now_preferences;
GCMEncryption _gcm_encryption(esp_now_encryption_key, esp_now_encryption_secret);
#ifdef PLATFORMIO // Uses arduino_esp_crt_bundle_attach
EspNowNode _esp_now_node(_esp_now_crypt, _esp_now_preferences, FIRMWARE_VERSION, _on_status, _on_log,
                         arduino_esp_crt_bundle_attach);
#else // uses esp_crt_bundle_attach
EspNowNode _esp_now_node(_gcm_encryption, _esp_now_preferences, FIRMWARE_VERSION, _on_status, _on_log,
                         esp_crt_bundle_attach);
#endif

void setup() {
  Serial.begin(115200);

  _esp_now_preferences.initalizeNVS();

  // Setup node, send message, and then go to sleep.
  if (_esp_now_node.setup()) {
    MyApplicationMessage message;
    message.temperature = 25.6;
    auto result = _esp_now_node.sendMessage(&message, sizeof(MyApplicationMessage));
    if (result) {
      auto payload_size = result.value().payload.size;
      if (payload_size > 0) {
        Serial.println("Got payload with size " + payload_size);

        auto payload = result.value().payload.buffer;
        Serial.print("Payload (HEX): ");
        for (size_t i = 0; i < payload_size; ++i) {
          if (payload[i] < 0x10)
            Serial.print("0");
          Serial.print(payload[i], HEX);
          Serial.print(" ");
        }
        Serial.println();
      }
      Serial.println("Got timestamp: " + String(result.value().timestamp));
    } else {
      Serial.println("Failed to send message.");
    }
  }

  esp_deep_sleep(SLEEP_TIME_US);
}

void loop() {}
